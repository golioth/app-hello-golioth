## west.yml
```yaml
# Copyright (c) 2021 Nordic Semiconductor ASA
# SPDX-License-Identifier: Apache-2.0

manifest:
  self:
    path: example-application

  #remotes:
   # - name: zephyrproject-rtos
    
   #url-base: https://github.com/zephyrproject-rtos

  projects:
    #- name: zephyr
    #  remote: zephyrproject-rtos
    #  revision: main
    #  import: true

  # Golioth repository.
    - name: golioth
      path: modules/lib/golioth
      revision: main
      url: https://github.com/golioth/zephyr-sdk.git
      import: true
```
